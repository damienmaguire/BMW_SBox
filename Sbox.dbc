VERSION ""

NS_ :

BS_:
BU_:
BO_ 544 PostContactorVoltage: 8 Vector__XXX
   SG_ Bus_Voltage : 0|24@1+ (0.001,0) [0|16777.2] "" Vector__XXX

BO_ 1296 Status: 8 Vector__XXX
   SG_ KL30C_Status : 28|1@1- (1,0) [0|0] "" Vector__XXX

BO_ 512 Current: 8 Vector__XXX
   SG_ Battery_Current : 0|25@1- (1,-12) [-300000|300000] "mA" Vector__XXX

BO_ 528 PackVoltage: 8 Vector__XXX
   SG_ Battery_Voltage : 0|24@1+ (0.001,0) [0|16777.2] "" Vector__XXX

BA_DEF_ BO_ "GenMsgBackgroundColor" STRING ;
BA_DEF_ BO_ "GenMsgForegroundColor" STRING ;
BA_DEF_DEF_ "GenMsgBackgroundColor" "#ffffff";
BA_DEF_DEF_ "GenMsgForegroundColor" "#000000";
VAL_ 1296 KL30C_Status 1 "KL30C Power absent" 0 "KL30C Power present";
